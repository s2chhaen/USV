/////////////////////////////////////////////////////////////////////////////////////////
//
//
// FIFOa.S
//
// Created: 20.07.2023 20:58:33
//  Author: Franke
//
//
// rev 1.1 runtime optimisation; 2023.07.20
//
/////////////////////////////////////////////////////////////////////////////////////////

#ifndef FIFOA_S_
#define FIFOA_S_

#include "FIFO.h"

/////////////////////////////////////////////////////////////////////////////////////////
// assembler defines
/////////////////////////////////////////////////////////////////////////////////////////
#define I1L r24
#define I1H r25
#define I2L r22
#define I2H r23
#define I3L r20
#define I3H r21
#define O1L r24
#define O1H r25

#define _ZR r1
#define  XL r26
#define  XH r27
#define  YL r28
#define  YH r29
#define  ZL r30
#define  ZH r31

 .section .text

 .global FIFO_writebyte
 /////////////////////////////////////////////////////////////////////////////////////////
 // bool FIFO_writebyte(sFIFO_t* FIFO, uint8_t byte) __attribute__((used))
 //	bool (R24) FIFO_writebyte(sFIFO_t* (R25,R24), uint8_t (R22))
 // {
 /////////////////////////////////////////////////////////////////////////////////////////
 FIFO_writebyte:
 MOVW r30, r24
 LDD  r24, z+_p_read
 LDD  r25, z+_p_write
 INC  r25
 ANDI r25, _FIFO_bits
 CP   r24, r25
 LDI  r24, 0
 BREQ __FWB2_end
 LDD  r24, z+_p_write
 MOVW r26, r30
 ADD  r26, r24
 ADC  r26, r1
 #if _p_data!=0
 ADIW r26, _p_data
 #endif
 ST   x,   r22
 STD  z+_p_write, r25
 LDI  r24, 1
 __FWB2_end:
 ret

 /////////////////////////////////////////////////////////////////////////////////////////
 // }
 /////////////////////////////////////////////////////////////////////////////////////////

  .global FIFO_readbyte
 /////////////////////////////////////////////////////////////////////////////////////////
 // bool FIFO_readbyte(sFIFO_t* FIFO, uint8_t* byte) __attribute__((used))
 //	bool (R24) FIFO_readbyte(sFIFO_t* (R25,R24), uint8_t* (R23,R22))
 // {
 /////////////////////////////////////////////////////////////////////////////////////////
 FIFO_readbyte:
 MOVW  ZL, I1L
 LDD  r25, z+_p_read
 LDD  r24, z+_p_write
 CP   r24, r25
 LDI  O1L, 0
 BREQ __FRB2_end
 MOVW  XL, ZL
 ADD   XL, r25
 ADC   XH, _ZR
 #if _p_data!=0
 ADIW  XL, _p_data
 #endif
 LD   r24, x
 MOVW  XL, r22
 ST     x, r24
 INC  r25
 ANDI r25, _FIFO_bits
 STD  z+_p_read, r25
 LDI  O1L, 1
 __FRB2_end:
 ret
 /////////////////////////////////////////////////////////////////////////////////////////
 // }
 /////////////////////////////////////////////////////////////////////////////////////////

#endif

// EOF //
