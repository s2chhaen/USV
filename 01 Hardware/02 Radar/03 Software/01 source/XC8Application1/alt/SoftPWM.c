//////////////////////////////////////////////////////////////////////////////////////////////////// 
// SoftPWM.c
//
// Created: 02.12.2019 12:10:27
//  Author: franke
//////////////////////////////////////////////////////////////////////////////////////////////////// 

#include "SoftPWM.h"
#include "../Timer/TimerCounterA0.h"
#include "../../Eventsystem/Eventsystem.h"

#include <Math/MinMax.h>
#include <string.h>


////////////////////////////////////////////////////////////////////////////////////////////////////
// lokale defines
////////////////////////////////////////////////////////////////////////////////////////////////////
#define max_PWMs 8

#define PWM_ports_CLKDIV_Tab {TCA_SINGLE_CLKSEL_DIV4,TCA_SINGLE_CLKSEL_DIV2,TCA_SINGLE_CLKSEL_DIV2,\
	TCA_SINGLE_CLKSEL_DIV1,TCA_SINGLE_CLKSEL_DIV1,TCA_SINGLE_CLKSEL_DIV1,TCA_SINGLE_CLKSEL_DIV1,\
	TCA_SINGLE_CLKSEL_DIV1}
	
////////////////////////////////////////////////////////////////////////////////////////////////////
// lokale types
////////////////////////////////////////////////////////////////////////////////////////////////////
typedef enum SoftPWM_State_enum
{
	On,
	Off,
}SoftPWM_State_t;

////////////////////////////////////////////////////////////////////////////////////////////////////
// lokale Variablen
////////////////////////////////////////////////////////////////////////////////////////////////////
uint8_t n_CMP_Val = 0;
uint8_t CMP_Val_Index;
uint16_t CMP_Val_Arr[max_PWMs];
uint8_t softPWM_PinoutMask;
PORT_t* PWM_Port;
SoftPWM_State_t softPWM_State;

////////////////////////////////////////////////////////////////////////////////////////////////////
// lokale Funktionsdeklaration
////////////////////////////////////////////////////////////////////////////////////////////////////
void SoftPWM_Callback(uint8_t event_ID, uint8_t eventdata);

////////////////////////////////////////////////////////////////////////////////////////////////////
// lokale Funktionen
////////////////////////////////////////////////////////////////////////////////////////////////////

////////////////////////////////////////////////////////////////////////////////////////////////////
// void init_SoftPWM(uint32_t per_us, uint8_t PWM_outputs, PORT_PWM_t Port)
////////////////////////////////////////////////////////////////////////////////////////////////////
uint8_t init_SoftPWM(uint32_t per_us, uint8_t PWM_outputs, PORT_t* Port)
{
	uint8_t retval = 0;
	//uint8_t Table_CLKDIV[] = PWM_ports_CLKDIV_Tab;
	// initalisieren der SoftPWM Variablen
	n_CMP_Val = MIN(PWM_outputs,8);
	CMP_Val_Index = 0;
	memset(CMP_Val_Arr, 0, sizeof(CMP_Val_Arr));
	
	PWM_Port = Port;
	softPWM_PinoutMask = (0xFF>>(max_PWMs-PWM_outputs));
	softPWM_State = Off;
	
	// Initialisierung von Timer A0
	TimerCounterA0_set_CLKSEL_and_lock(TCA_SINGLE_CLKSEL_DIV1);
	retval |= TimerCounterA0_PWMInit(UINT32_MAX, false, 0);
	TimerCounterA0_set_INTCRTL(TCA_SINGLE_OVF_bm|TCA_SINGLE_CMP0_bm);
	
	TimerCounterA0_SetOVFCallbackFnc(SoftPWM_Callback);
	TimerCounterA0_SetCMP0CallbackFnc(SoftPWM_Callback);
	
	
	PWM_Port->DIRSET = softPWM_PinoutMask;
	
	
	return retval;
}

////////////////////////////////////////////////////////////////////////////////////////////////////
// void set_SoftPWM_CMP(uint8_t Channel, uint16_t CMP_Val)
////////////////////////////////////////////////////////////////////////////////////////////////////
void set_SoftPWM_CMP(uint8_t Channel, uint16_t CMP_Val)
{
	if((Channel < n_CMP_Val) && (Channel<max_PWMs))
	{
		CMP_Val_Arr[Channel] = CMP_Val;
	}
}

////////////////////////////////////////////////////////////////////////////////////////////////////
// void SoftPWM_Callback(uint8_t event_ID, uint8_t eventdata)
//  Callbackfunktion für die Pinänderung aller PWMs
////////////////////////////////////////////////////////////////////////////////////////////////////
void SoftPWM_Callback(uint8_t event_ID, uint8_t eventdata)
{
	switch(event_ID)
	{
		case TCA0_OVF_vect_num:
			PWM_Port->OUT |= softPWM_PinoutMask&(1<<CMP_Val_Index);
			if(CMP_Val_Index < (n_CMP_Val-1))
				CMP_Val_Index++; 
			else
				CMP_Val_Index = 0;
			TimerCounterA0_set_CMPBUF(0,CMP_Val_Arr[CMP_Val_Index]);
		break;
		case TCA0_CMP0_vect_num:
			PWM_Port->OUT &= ~(softPWM_PinoutMask);
		break;
	}
}

////////////////////////////////////////////////////////////////////////////////////////////////////
// void SoftPWM_On(void)
//  Schalte die SoftPWM an
////////////////////////////////////////////////////////////////////////////////////////////////////
void SoftPWM_On(void)
{
	softPWM_State = On;
	TimerCounterA0_On();
}

////////////////////////////////////////////////////////////////////////////////////////////////////
// void SoftPWM_Off(void)
//  Schalte die SoftPWM aus
////////////////////////////////////////////////////////////////////////////////////////////////////
void SoftPWM_Off(void)
{
	TimerCounterA0_Off();
	softPWM_State = Off;
}

//EOF//
